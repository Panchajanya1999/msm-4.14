/*
 * Copyright (C) 2020 The LineageOS Project
 *
 * this file is for attribution only of violet
 * And public attribution of Xiaomi platforms (like F7B and so)
 */

&soc {
    goodix_fp {
        compatible = "goodix,fingerprint";
        interrupt-parent = <&tlmm>;
        interrupt = <93 0x0>;
        vcc_spi-supply = <&pm6150l_l7>;
        vcc_ana-supply = <&pm6150l_l7>;
        vdd_io-supply = <&pm6150l_l7>;
        fp-gpio-irq = <&tlmm 93 0x00>;
        fp-gpio-reset = <&tlmm 101 0x00>;
        status = "okay";
    };

    fpc1020 {
        status = "ok";
        compatible = "fpc,fpc1020";
        interrupt-parent = <&tlmm>;
        interrupts = <93 0x0>;
        fpc,gpio_rst    = <&tlmm 101 0x0>;
        fpc,gpio_irq    = <&tlmm 93 0x0>;
        vcc_spi-supply  = <&pm6150l_l10>;
        vdd_io-supply   = <&pm6150l_l10>;
        vdd_ana-supply  = <&pm6150l_l10>;
        pinctrl-names = "fpc1020_reset_reset",
            "fpc1020_reset_active",
            "fpc1020_irq_active";
        pinctrl-0 = <&msm_gpio_101>;
        pinctrl-1 = <&msm_gpio_101_output_high>;
        pinctrl-2 = <&msm_gpio_93>;
    };
};