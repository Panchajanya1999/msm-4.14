/* Copyright (c) 2018, The Linux Foundation. All rights reserved.
 * Copyright (C) 2019 XiaoMi, Inc.
 *
 * This program is free software; you can redistribute it and/or modify
 * it under the terms of the GNU General Public License version 2 and
 * only version 2 as published by the Free Software Foundation.
 *
 * This program is distributed in the hope that it will be useful,
 * but WITHOUT ANY WARRANTY; without even the implied warranty of
 * MERCHANTABILITY or FITNESS FOR A PARTICULAR PURPOSE.  See the
 * GNU General Public License for more details.
 */

&mdss_mdp {
	dsi_nt36672a_shenchao_video: qcom,mdss_dsi_nt36672a_shenchao_fhd_video {
		qcom,mdss-dsi-panel-name =
			"nt36672a video mode dsi shenchao panel";
		qcom,mdss-dsi-panel-type = "dsi_video_mode";
		qcom,mdss-dsi-virtual-channel-id = <0>;
		qcom,mdss-pan-physical-width-dimension = <67>;
		qcom,mdss-pan-physical-height-dimension = <145>;
		qcom,mdss-dsi-stream = <0>;
		qcom,mdss-dsi-h-left-border = <0>;
		qcom,mdss-dsi-h-right-border = <0>;
		qcom,mdss-dsi-v-top-border = <0>;
		qcom,mdss-dsi-v-bottom-border = <0>;
		qcom,mdss-dsi-bpp = <24>;
		qcom,mdss-dsi-color-order = "rgb_swap_rgb";
		qcom,mdss-dsi-underflow-color = <0xff>;
		qcom,mdss-dsi-border-color = <0>;
		qcom,mdss-dsi-h-sync-pulse = <0>;
		qcom,mdss-dsi-traffic-mode = "burst_mode";
		qcom,mdss-dsi-lane-map = "lane_map_0123";
		qcom,mdss-dsi-bllp-eof-power-mode;
		qcom,mdss-dsi-bllp-power-mode;
		qcom,mdss-dsi-tx-eot-append;
		qcom,mdss-dsi-lane-0-state;
		qcom,mdss-dsi-lane-1-state;
		qcom,mdss-dsi-lane-2-state;
		qcom,mdss-dsi-lane-3-state;
		qcom,mdss-dsi-dma-trigger = "trigger_sw";
		qcom,mdss-dsi-mdp-trigger = "none";
		qcom,mdss-dsi-lp11-init;
		qcom,mdss-dsi-force-clock-lane-hs;
		qcom,mdss-dsi-bl-pmic-control-type = "bl_ctrl_wled";
		qcom,mdss-dsi-bl-min-level = <1>;
		qcom,mdss-dsi-bl-max-level = <4095>;
		qcom,mdss-brightness-max-level = <4095>;
		qcom,mdss-dsi-reset-sequence = <1 1>, <0 1>, <1 10>;

		qcom,mdss-dsi-display-timings {
			timing@0 {
				qcom,mdss-dsi-panel-width = <1080>;
				qcom,mdss-dsi-panel-height = <2340>;
				qcom,mdss-dsi-h-front-porch = <90>;
				qcom,mdss-dsi-h-back-porch = <120>;
				qcom,mdss-dsi-h-pulse-width = <2>;
				qcom,mdss-dsi-h-sync-skew = <0>;
				qcom,mdss-dsi-v-back-porch = <8>;
				qcom,mdss-dsi-v-front-porch = <13>;
				qcom,mdss-dsi-v-pulse-width = <3>;
				qcom,mdss-dsi-panel-framerate = <60>;
				qcom,mdss-dsi-on-command = [
					15 01 00 00 00 00 02 ff 23 
					15 01 00 00 00 00 02 fb 01 
					15 01 00 00 00 00 02 07 20 
					15 01 00 00 00 00 02 08 04 
					15 01 00 00 00 00 02 09 00 
					15 01 00 00 00 00 02 ff 25 
					15 01 00 00 00 00 02 fb 01 
					15 01 00 00 00 00 02 18 96 
					15 01 00 00 00 00 02 05 04 
					15 01 00 00 00 00 02 ff 27 
					15 01 00 00 00 00 02 fb 01 
					15 01 00 00 00 00 02 d9 10 
					15 01 00 00 00 00 02 ff 24 
					15 01 00 00 00 00 02 fb 01 
					15 01 00 00 00 00 02 82 13 
					15 01 00 00 00 00 02 84 31 
					15 01 00 00 00 00 02 88 13 
					15 01 00 00 00 00 02 8a 31 
					15 01 00 00 00 00 02 8e e4 
					15 01 00 00 00 00 02 8f 01 
					15 01 00 00 00 00 02 90 80 
					15 01 00 00 00 00 02 9d b0 
					15 01 00 00 00 00 02 ff 26 
					15 01 00 00 00 00 02 fb 01 
					15 01 00 00 00 00 02 a9 12 
					15 01 00 00 00 00 02 aa 10 
					15 01 00 00 00 00 02 ae 8a 
					15 01 00 00 00 00 02 1c fa 
					15 01 00 00 00 00 02 ff 10 
					15 01 00 00 00 00 02 b0 01 
					15 01 00 00 00 00 02 51 b8
					39 01 00 00 00 00 03 68 06
					04 15 01 00 00 00 00 02 53
					2c 15 01 00 00 00 00 02 55
					00 05 01 00 00 00 00 02 29
					00 05 01 00 00 46 00 02 11
					00];
				qcom,mdss-dsi-off-command = [
					05 01 00 00 14 00 02 28 00 
					05 01 00 00 78 00 02 10 00];
				qcom,mdss-dsi-ce-on-command = [];
				qcom,mdss-dsi-ce-off-command = [];
				qcom,mdss-dsi-srgb-on-command = [];
				qcom,mdss-dsi-srgb-off-command = [];
				qcom,mdss-dsi-cabc-on-command = [
					15 01 00 00 00 00 02 ff 23 
					15 00 00 00 00 00 02 fb 01 
					15 00 00 00 00 00 02 01 84 
					15 00 00 00 00 00 02 05 04 
					15 00 00 00 00 00 02 05 2d 
					15 00 00 00 00 00 02 06 00 
					15 00 00 00 00 00 02 11 01 
					15 00 00 00 00 00 02 12 8a 
					15 00 00 00 00 00 02 15 6a 
					15 01 00 00 00 00 02 16 0b 
					15 00 00 00 00 00 02 19 00 
					15 00 00 00 00 00 02 1a 04 
					15 00 00 00 00 00 02 1b 08 
					15 00 00 00 00 00 02 1c 0c 
					15 00 00 00 00 00 02 1d 10 
					15 00 00 00 00 00 02 1e 2a 
					15 00 00 00 00 00 02 1f 3f 
					15 00 00 00 00 00 02 20 3f 
					15 00 00 00 00 00 02 21 30 
					15 01 00 00 00 00 02 22 2e 
					15 00 00 00 00 00 02 23 30 
					15 00 00 00 00 00 02 24 37 
					15 00 00 00 00 00 02 25 38 
					15 00 00 00 00 00 02 26 2c 
					15 00 00 00 00 00 02 27 24 
					15 00 00 00 00 00 02 28 28 
					15 00 00 00 00 00 02 29 80 
					15 00 00 00 00 00 02 30 fd 
					15 00 00 00 00 00 02 31 fc 
					15 01 00 00 00 00 02 32 f8 
					15 00 00 00 00 00 02 33 f6 
					15 00 00 00 00 00 02 34 f5 
					15 00 00 00 00 00 02 35 f4 
					15 00 00 00 00 00 02 36 f3 
					15 00 00 00 00 00 02 37 f3 
					15 00 00 00 00 00 02 38 f2 
					15 00 00 00 00 00 02 39 f0 
					15 00 00 00 00 00 02 3a ee 
					15 00 00 00 00 00 02 3b ec 
					15 01 00 00 00 00 02 3d ea 
					15 00 00 00 00 00 02 3f e8 
					15 00 00 00 00 00 02 40 e6 
					15 01 00 00 00 00 02 41 e5 
					15 01 00 00 00 00 02 ff 10 
					15 00 00 00 00 00 02 fb 01 
					15 01 00 00 00 00 02 55 01
					00 05 01 00 00 00 00 02 29
					00 05 01 00 00 46 00 02 11
					00];
				qcom,mdss-dsi-cabc-off-command = [
					15 01 00 00 00 00 02 ff 10 
					15 01 00 00 00 00 02 55 00
					00 05 01 00 00 00 00 02 29
					00 05 01 00 00 46 00 02 11
					00];
				qcom,mdss-dsi-cabc_movie-on-command = [
					15 01 00 00 00 00 02 ff 23 
					15 00 00 00 00 00 02 fb 01 
					15 00 00 00 00 00 02 01 84 
					15 00 00 00 00 00 02 05 04 
					15 00 00 00 00 00 02 05 2d 
					15 00 00 00 00 00 02 06 00 
					15 00 00 00 00 00 02 11 01 
					15 00 00 00 00 00 02 12 8a 
					15 00 00 00 00 00 02 15 6a 
					15 01 00 00 00 00 02 16 0b 
					15 00 00 00 00 00 02 19 00 
					15 00 00 00 00 00 02 1a 04 
					15 00 00 00 00 00 02 1b 08 
					15 00 00 00 00 00 02 1c 0c 
					15 00 00 00 00 00 02 1d 10 
					15 00 00 00 00 00 02 1e 2a 
					15 00 00 00 00 00 02 1f 3f 
					15 00 00 00 00 00 02 20 3f 
					15 00 00 00 00 00 02 21 30 
					15 01 00 00 00 00 02 22 2e 
					15 00 00 00 00 00 02 23 30 
					15 00 00 00 00 00 02 24 37 
					15 00 00 00 00 00 02 25 38 
					15 00 00 00 00 00 02 26 2c 
					15 00 00 00 00 00 02 27 24 
					15 00 00 00 00 00 02 28 28 
					15 00 00 00 00 00 02 2b 87 
					15 00 00 00 00 00 02 58 e4 
					15 00 00 00 00 00 02 59 e4 
					15 01 00 00 00 00 02 5a e4 
					15 00 00 00 00 00 02 5b e4 
					15 00 00 00 00 00 02 5c e4 
					15 00 00 00 00 00 02 5d e4 
					15 00 00 00 00 00 02 5e df 
					15 00 00 00 00 00 02 5f da 
					15 00 00 00 00 00 02 60 d7 
					15 00 00 00 00 00 02 61 d0 
					15 00 00 00 00 00 02 62 cd 
					15 00 00 00 00 00 02 63 ca 
					15 01 00 00 00 00 02 64 c8 
					15 00 00 00 00 00 02 65 c1 
					15 00 00 00 00 00 02 66 bb 
					15 01 00 00 00 00 02 67 b3 
					15 01 00 00 00 00 02 ff 10 
					15 00 00 00 00 00 02 fb 01 
					15 01 00 00 00 00 02 55 03
					00 05 01 00 00 00 00 02 29
					00 05 01 00 00 46 00 02 11
					00];
				qcom,mdss-dsi-cabc_still-on-command = [
					15 01 00 00 00 00 02 ff 23 
					15 00 00 00 00 00 02 fb 01 
					15 00 00 00 00 00 02 01 84 
					15 00 00 00 00 00 02 05 04 
					15 00 00 00 00 00 02 05 2d 
					15 00 00 00 00 00 02 06 00 
					15 00 00 00 00 00 02 11 01 
					15 00 00 00 00 00 02 12 8a 
					15 00 00 00 00 00 02 15 6a 
					15 01 00 00 00 00 02 16 0b 
					15 00 00 00 00 00 02 19 00 
					15 00 00 00 00 00 02 1a 04 
					15 00 00 00 00 00 02 1b 08 
					15 00 00 00 00 00 02 1c 0c 
					15 00 00 00 00 00 02 1d 10 
					15 00 00 00 00 00 02 1e 2a 
					15 00 00 00 00 00 02 1f 3f 
					15 00 00 00 00 00 02 20 3f 
					15 00 00 00 00 00 02 21 30 
					15 01 00 00 00 00 02 22 2e 
					15 00 00 00 00 00 02 23 30 
					15 00 00 00 00 00 02 24 37 
					15 00 00 00 00 00 02 25 38 
					15 00 00 00 00 00 02 26 2c 
					15 00 00 00 00 00 02 27 24 
					15 00 00 00 00 00 02 28 28 
					15 00 00 00 00 00 02 2a 3f 
					15 00 00 00 00 00 02 45 e4 
					15 00 00 00 00 00 02 46 e4 
					15 01 00 00 00 00 02 47 e4 
					15 00 00 00 00 00 02 48 e4 
					15 00 00 00 00 00 02 49 e4 
					15 00 00 00 00 00 02 4a e4 
					15 00 00 00 00 00 02 4b d0 
					15 00 00 00 00 00 02 4c b2 
					15 00 00 00 00 00 02 4d af 
					15 00 00 00 00 00 02 4e aa 
					15 00 00 00 00 00 02 4f a4 
					15 00 00 00 00 00 02 50 9a 
					15 01 00 00 00 00 02 51 90 
					15 00 00 00 00 00 02 52 85 
					15 00 00 00 00 00 02 53 7a 
					15 01 00 00 00 00 02 54 66 
					15 01 00 00 00 00 02 ff 10 
					15 00 00 00 00 00 02 fb 01 
					15 01 00 00 00 00 02 55 02];
				qcom,mdss-dsi-on-command-state = "dsi_lp_mode";
				qcom,mdss-dsi-off-command-state = "dsi_hs_mode";
				qcom,mdss-dsi-ce-on-command-state = "dsi_hs_mode";
				qcom,mdss-dsi-ce-off-command-state = "dsi_hs_mode";
				qcom,mdss-dsi-srgb-on-command-state = "dsi_hs_mode";
				qcom,mdss-dsi-srgb-off-command-state = "dsi_hs_mode";
				qcom,mdss-dsi-cabc-on-command-state = "dsi_hs_mode";
				qcom,mdss-dsi-cabc-off-command-state = "dsi_hs_mode";
				qcom,mdss-dsi-cabc_movie-on-command-state = "dsi_hs_mode";
				qcom,mdss-dsi-cabc_still-on-command-state = "dsi_hs_mode";
			};
		};
	};
};
