## drivers/aircrack/mt7630/Kconfig
```kconfig
config MT7630
	tristate "MT7630 USB WiFi"
	depends on USB
	default m
	---help---
	  Help message of MT7630
```

## drivers/aircrack/rtl8188fu/Kconfig
```kconfig
# SPDX-License-Identifier: GPL-2.0
config RTL8188FU
	tristate "Realtek 8188F USB WiFi"
	depends on USB
	default m
	---help---
	  Help message of RTL8818FU
```

## drivers/input/fingerprint/Kconfig
```kconfig
menu "Fingerprint Drivers"

config FINGERPRINT_FPC1020
	tristate "FPC fpc1020 fingerprint driver support"
	help
	  say y here to enable fpc fingerprint driver support!  

config FINGERPRINT_GF3208
	tristate "Goodix gf3208 fingerprint driver support"
	help
	  say y here to enable gf3208 fingerprint driver support!

endmenu
```

## drivers/staging/qcacld-3.0/Kconfig
```kconfig
comment "Qualcomm Atheros CLD WLAN module"

config QCA_CLD_WLAN
	tristate "Qualcomm Atheros CLD WLAN module"
	default n
	help
	  Add support for the Qualcomm Atheros CLD WLAN module

if QCA_CLD_WLAN != n

config QCA_CLD_WLAN_PROFILE
	string "Configuration profile for Qualcomm Atheros CLD WLAN module"
	default "default"
	help
	  Specify which configuration profile to be used for building
	  this module.
	  Profiles are located at drivers/staging/qcacld-3.0/configs.

config FEATURE_PKTLOG
	bool "Packet log"
	default n
	depends on SLUB_DEBUG
	depends on SLUB_DEBUG_ON
	depends on PAGE_POISONING

config QCA_CLD_DEBUG
	bool "Debug Qualcomm Atheros CLD WLAN module"
	default n

endif # QCA_CLD_WLAN
```
